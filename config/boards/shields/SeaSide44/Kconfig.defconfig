## config/boards/shields/SeaSide44/Kconfig.defconfig
```kconfig
# 既存構成設定
if SHIELD_SeaSide44_R

config ZMK_KEYBOARD_NAME
    default "SeaSide44_R"

config ZMK_SPLIT
    default y

config ZMK_SPLIT_ROLE_CENTRAL
    default y

endif

if SHIELD_SeaSide44_L

config ZMK_KEYBOARD_NAME
    default "SeaSide44_L"

config ZMK_SPLIT
    default y

endif

# 新規構成 (Prospector追加版)
# ドングル設定
if SHIELD_SEASIDE44_D

config ZMK_KEYBOARD_NAME
    default "SeaSide44"

config ZMK_SPLIT_ROLE_CENTRAL
    default y

config ZMK_SPLIT
    default y

config ZMK_SPLIT_BLE_CENTRAL_PERIPHERALS
    default 2

config ZMK_MOUSE
    default y

endif

# 左右ペリフェラル
# ペリフェラル専用シールド設定（新規）
if SHIELD_SEASIDE44_L_PERIPHERAL || SHIELD_SEASIDE44_R_PERIPHERAL

config ZMK_SPLIT
    default y

config ZMK_SPLIT_ROLE_CENTRAL
    default n

endif

if SHIELD_SEASIDE44_R_PERIPHERAL

config ZMK_MOUSE
    default y

config SPI
    default y

endif
```

## config/boards/shields/SeaSide44/Kconfig.shield
```kconfig
# 既存構成
config SHIELD_SeaSide44_R
    def_bool $(shields_list_contains,SeaSide44_R)

config SHIELD_SeaSide44_L
    def_bool $(shields_list_contains,SeaSide44_L)

# 新規構成
# ドングルシールド（新規）
config SHIELD_SEASIDE44_D
    def_bool $(shields_list_contains,SeaSide44_D)

# ドングル用ペリフェラルシールド（新規）
config SHIELD_SEASIDE44_L_PERIPHERAL
    def_bool $(shields_list_contains,SeaSide44_L_peripheral)

config SHIELD_SEASIDE44_R_PERIPHERAL
    def_bool $(shields_list_contains,SeaSide44_R_peripheral)
```

## config/west.yml
```yaml
manifest:
  remotes:
    - name: zmkfirmware
      url-base: https://github.com/zmkfirmware
    - name: inorichi
      url-base: https://github.com/inorichi
    - name: caksoylar
      url-base: https://github.com/caksoylar
    - name: carrefinho
      url-base: https://github.com/carrefinho
  projects:
    - name: zmk
      remote: zmkfirmware
      revision: v0.3
      import: app/west.yml
    - name: zmk-pmw3610-driver
      path: ../modules/zmk-pmw3610-driver
      revision: main
    - name: zmk-rgbled-widget
      remote: caksoylar
      revision: v0.3-branch
    - name: prospector-zmk-module
      remote: carrefinho
      revision: main
  self:
    path: config
```
